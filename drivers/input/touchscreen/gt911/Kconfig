## drivers/input/touchscreen/gt911/Kconfig
```kconfig
#
#  Touchscreen driver configuration
#
config  INPUT_TOUCHSCREEN_GT911
       tristate  "gt911 touchscreen driver"      
       depends on INPUT && I2C
       select INPUT_SENSORINIT
       default m
       help
         gt911 touchscreen driver    
         
```
